## contrib/Config.in
```kconfig
#source "$BR2_EXTERNAL/packages/augeas/Config.in"
source "$BR2_EXTERNAL/packages/ntpclient/Config.in"
source "$BR2_EXTERNAL/packages/libowfs/Config.in"
source "$BR2_EXTERNAL/packages/mjpeg-streamer/Config.in"
source "$BR2_EXTERNAL/packages/xmon/Config.in"
source "$BR2_EXTERNAL/packages/zic/Config.in"

source "$BR2_EXTERNAL/packages/nucpackgen/Config.in.host"
```

## contrib/configs/vt300_defconfig
```kconfig
BR2_arm=y
BR2_GLOBAL_PATCH_DIR="../contrib/patches"
BR2_KERNEL_HEADERS_3_10=y
BR2_TOOLCHAIN_BUILDROOT_INET_RPC=y
BR2_TOOLCHAIN_BUILDROOT_WCHAR=y
BR2_TOOLCHAIN_BUILDROOT_CXX=y
BR2_GCC_ENABLE_LTO=y
BR2_GCC_ENABLE_GRAPHITE=y
BR2_PACKAGE_HOST_GDB=y
BR2_TARGET_GENERIC_HOSTNAME="hostname"
BR2_ROOTFS_DEVICE_CREATION_DYNAMIC_EUDEV=y
BR2_TARGET_GENERIC_ROOT_PASSWD="vt300"
BR2_TARGET_GENERIC_GETTY_PORT="ttyS0"
# BR2_TARGET_GENERIC_REMOUNT_ROOTFS_RW is not set
BR2_ROOTFS_OVERLAY="../contrib/rootfs_overlay"
BR2_ROOTFS_POST_BUILD_SCRIPT="../contrib/post_build.sh"
BR2_ROOTFS_POST_IMAGE_SCRIPT="../contrib/updater/make_pack.sh ../contrib/updater/make_update.sh"
BR2_LINUX_KERNEL=y
BR2_LINUX_KERNEL_CUSTOM_GIT=y
BR2_LINUX_KERNEL_CUSTOM_REPO_URL="git@github.com:Vutlan/Skycontrol-kernel.git"
BR2_LINUX_KERNEL_CUSTOM_REPO_VERSION="opennuvoton-vutlan"
BR2_LINUX_KERNEL_USE_CUSTOM_CONFIG=y
BR2_LINUX_KERNEL_CUSTOM_CONFIG_FILE="$(BR2_EXTERNAL)/kernel/vt300_config"
BR2_LINUX_KERNEL_UIMAGE=y
BR2_PACKAGE_BUSYBOX_CONFIG_FRAGMENT_FILES="../contrib/configs/busybox.contrib.config"
BR2_PACKAGE_BZIP2=y
BR2_PACKAGE_LZOP=y
BR2_PACKAGE_CACHE_CALIBRATOR=y
BR2_PACKAGE_MEMSTAT=y
BR2_PACKAGE_NETPERF=y
BR2_PACKAGE_RAMSPEED=y
BR2_PACKAGE_SPIDEV_TEST=y
BR2_PACKAGE_STRACE=y
BR2_PACKAGE_STRESS=y
BR2_PACKAGE_TINYMEMBENCH=y
BR2_PACKAGE_WHETSTONE=y
BR2_PACKAGE_DOSFSTOOLS=y
BR2_PACKAGE_DOSFSTOOLS_FATLABEL=y
BR2_PACKAGE_DOSFSTOOLS_FSCK_FAT=y
BR2_PACKAGE_DOSFSTOOLS_MKFS_FAT=y
BR2_PACKAGE_E2FSPROGS=y
BR2_PACKAGE_MMC_UTILS=y
BR2_PACKAGE_MTD=y
BR2_PACKAGE_MTD_FLASH_OTP_DUMP=y
BR2_PACKAGE_MTD_FLASH_OTP_INFO=y
BR2_PACKAGE_MTD_FLASH_OTP_WRITE=y
BR2_PACKAGE_MTD_JFFS2DUMP=y
BR2_PACKAGE_MTD_MKFSJFFS2=y
# BR2_PACKAGE_MTD_MTD_DEBUG is not set
BR2_PACKAGE_MTD_MTDPART=y
# BR2_PACKAGE_MTD_NANDDUMP is not set
# BR2_PACKAGE_MTD_NANDTEST is not set
# BR2_PACKAGE_MTD_NANDWRITE is not set
BR2_PACKAGE_MTD_RFDDUMP=y
BR2_PACKAGE_MTD_RFDFORMAT=y
BR2_PACKAGE_MTD_SERVE_IMAGE=y
BR2_PACKAGE_MTD_SUMTOOL=y
# BR2_PACKAGE_MTD_UBIATTACH is not set
# BR2_PACKAGE_MTD_UBICRC32 is not set
# BR2_PACKAGE_MTD_UBIDETACH is not set
# BR2_PACKAGE_MTD_UBIFORMAT is not set
# BR2_PACKAGE_MTD_UBIMKVOL is not set
# BR2_PACKAGE_MTD_UBINFO is not set
# BR2_PACKAGE_MTD_UBINIZE is not set
# BR2_PACKAGE_MTD_UBIRENAME is not set
# BR2_PACKAGE_MTD_UBIRMVOL is not set
# BR2_PACKAGE_MTD_UBIRSVOL is not set
# BR2_PACKAGE_MTD_UBIUPDATEVOL is not set
# BR2_PACKAGE_MTD_UBIBLOCK is not set
BR2_PACKAGE_EEPROG=y
BR2_PACKAGE_I2C_TOOLS=y
BR2_PACKAGE_IOSTAT=y
BR2_PACKAGE_MEMTESTER=y
BR2_PACKAGE_NANOCOM=y
BR2_PACKAGE_SETSERIAL=y
BR2_PACKAGE_USB_MODESWITCH_DATA=y
BR2_PACKAGE_CA_CERTIFICATES=y
BR2_PACKAGE_OPENSSL_BIN=y
BR2_PACKAGE_OPENSSL_ENGINES=y
BR2_PACKAGE_SQLITE=y
BR2_PACKAGE_LIBMBIM=y
BR2_PACKAGE_LIBQMI=y
BR2_PACKAGE_LIBUSB_COMPAT=y
BR2_PACKAGE_EXPAT=y
BR2_PACKAGE_LIBXML2=y
BR2_PACKAGE_ZLOG=y
BR2_PACKAGE_FREERADIUS_CLIENT=y
BR2_PACKAGE_LIBCURL=y
BR2_PACKAGE_CURL=y
BR2_PACKAGE_LIBFCGI=y
BR2_PACKAGE_ARGP_STANDALONE=y
BR2_PACKAGE_LIBEVENT=y
BR2_PACKAGE_READLINE=y
BR2_PACKAGE_CAN_UTILS=y
BR2_PACKAGE_DROPBEAR=y
BR2_PACKAGE_IPROUTE2=y
BR2_PACKAGE_NETSNMP=y
# BR2_PACKAGE_NETSNMP_ENABLE_MIBS is not set
BR2_PACKAGE_NGINX=y
BR2_PACKAGE_NGINX_HTTP_CACHE=y
BR2_PACKAGE_NGINX_HTTP_SSL_MODULE=y
BR2_PACKAGE_NGINX_HTTP_V2_MODULE=y
BR2_PACKAGE_NGINX_HTTP_ADDITION_MODULE=y
BR2_PACKAGE_NGINX_HTTP_GZIP_STATIC_MODULE=y
# BR2_PACKAGE_NGINX_HTTP_GZIP_MODULE is not set
# BR2_PACKAGE_NGINX_HTTP_USERID_MODULE is not set
# BR2_PACKAGE_NGINX_HTTP_ACCESS_MODULE is not set
# BR2_PACKAGE_NGINX_HTTP_AUTH_BASIC_MODULE is not set
# BR2_PACKAGE_NGINX_HTTP_GEO_MODULE is not set
# BR2_PACKAGE_NGINX_HTTP_SPLIT_CLIENTS_MODULE is not set
# BR2_PACKAGE_NGINX_HTTP_REFERER_MODULE is not set
# BR2_PACKAGE_NGINX_HTTP_UWSGI_MODULE is not set
# BR2_PACKAGE_NGINX_HTTP_SCGI_MODULE is not set
# BR2_PACKAGE_NGINX_HTTP_MEMCACHED_MODULE is not set
# BR2_PACKAGE_NGINX_HTTP_LIMIT_CONN_MODULE is not set
# BR2_PACKAGE_NGINX_HTTP_LIMIT_REQ_MODULE is not set
# BR2_PACKAGE_NGINX_HTTP_EMPTY_GIF_MODULE is not set
# BR2_PACKAGE_NGINX_HTTP_BROWSER_MODULE is not set
# BR2_PACKAGE_NGINX_HTTP_UPSTREAM_IP_HASH_MODULE is not set
# BR2_PACKAGE_NGINX_HTTP_UPSTREAM_LEAST_CONN_MODULE is not set
# BR2_PACKAGE_NGINX_HTTP_UPSTREAM_KEEPALIVE_MODULE is not set
BR2_PACKAGE_OPENVPN=y
BR2_PACKAGE_OPENVPN_SMALL=y
BR2_PACKAGE_OPENVPN_PWSAVE=y
BR2_TARGET_ROOTFS_JFFS2=y
BR2_TARGET_ROOTFS_JFFS2_FLASH_64=y
BR2_TARGET_ROOTFS_JFFS2_PAD=y
BR2_TARGET_ROOTFS_JFFS2_SUMMARY=y
BR2_TARGET_UBOOT=y
BR2_TARGET_UBOOT_BOARDNAME="nuc970_nonand"
BR2_TARGET_UBOOT_CUSTOM_GIT=y
BR2_TARGET_UBOOT_CUSTOM_REPO_URL="git@github.com:Vutlan/nuc970-uboot.git"
BR2_TARGET_UBOOT_CUSTOM_REPO_VERSION="VT300-production-latest"
BR2_PACKAGE_NTPCLIENT=y
BR2_PACKAGE_LIBOWFS=y
BR2_PACKAGE_MJPEG_STREAMER=y
BR2_PACKAGE_XMON=y
BR2_PACKAGE_ZIC=y
BR2_PACKAGE_HOST_NUCPACKGEN=y
```

## contrib/packages/ch34/Config.in
```kconfig
config BR2_PACKAGE_CH34
        bool "ch34"
        depends on BR2_LINUX_KERNEL
        help
                Linux Kernel Module for CH34 support (USB-RS485).
```

## contrib/packages/cp210x/Config.in
```kconfig
config BR2_PACKAGE_CP210X
        bool "cp210x"
        depends on BR2_LINUX_KERNEL
        help
                Linux Kernel Module for CP210x support (USB-RS485).
```

## contrib/packages/example/Config.in
```kconfig
config BR2_PACKAGE_EXAMPLE
        bool "example"
        help
          This is a example

          http://example.com
```

## contrib/packages/libowfs/Config.in
```kconfig
config BR2_PACKAGE_LIBOWFS
        bool "libowfs"
        help
          This is the Library OWFS (libraries only)

          http://owfs.org/
```

## contrib/packages/ntpclient/Config.in
```kconfig
config BR2_PACKAGE_NTPCLIENT
        bool "ntpclient"
        help
          This is the ntpclient

          http://doolittle.icarus.com/ntpclient/
```

## contrib/packages/nucpackgen/Config.in.host
```kconfig
config BR2_PACKAGE_HOST_NUCPACKGEN
        bool "nucpackgen"
        help
          This is the host utility for NucWriter PACK generating

          https://github.com/Vutlan/NucPackGen
```

## contrib/packages/xmon/Config.in
```kconfig
config BR2_PACKAGE_XMON
        bool "xmon"
        help
          This is the eXpadable Monitoring system

          http://vutlan.com

choice
        prompt "Select brandname"
        help

config BR2_PACKAGE_XMON_VUTLAN
	bool "Vutlan"

config BR2_PACKAGE_XMON_DIDACTUM
	bool "Didactum"

config BR2_PACKAGE_XMON_BKT
	bool "BKT Elektronic"

config BR2_PACKAGE_XMON_SCHAFER
	bool "Schafer"

config BR2_PACKAGE_XMON_LANDE
	bool "Lande"

endchoice
```

## contrib/packages/zic/Config.in
```kconfig
config BR2_PACKAGE_ZIC
        bool "zic"
        help
          Zone info file compiler for timezone and DST support
```
